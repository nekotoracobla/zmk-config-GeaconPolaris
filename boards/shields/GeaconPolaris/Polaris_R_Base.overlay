#include <dt-bindings/zmk/bt.h>
#include <input/processors.dtsi>
#include <dt-bindings/zmk/input_transform.h>
#include <zephyr/dt-bindings/input/input-event-codes.h>
#include "Polaris.dtsi"
#include <dt-bindings/zmk/pointing.h>
#include <dt-bindings/zmk/modifiers.h>
#include <input/processors.dtsi>


/ {
    kscan0: kscan0 {
        compatible = "zmk,kscan-gpio-charlieplex";
        interrupt-gpios = MATRIX_INTERRUPT_GPIOS;
        gpios
            = MATRIX_GPIOS
            ;
    };

    scroll_inertia_v: scroll_inertia_v {
        compatible = "zmk,input-processor-scroll-inertia";
        #input-processor-cells = <0>;

        /* axis: 0 = 両軸（自由2D）,
                  1 = Y軸のみ（縦スクロール）,
                  2 = X軸のみ（横スクロール） */
        axis      = <1>;
        layer     = <5>;          /* 縦スクロール用のレイヤー番号 */

        /* 後段の zip_scroll_scaler の引数と合わせる */
        scale     = <4>;
        scale-div = <675>;

        /* オプション: Shiftを押している間だけ出力軸を反転 */
        swap-mod  = <(MOD_LSFT|MOD_RSFT)>;

        /* オプション: 右GUIを押している間だけ両軸フリー （2Dスクロール） */
        unlock-mod = <MOD_RGUI>;
    };

     trackball_listener: trackball_listener {
        compatible = "zmk,input-listener";
        device = <&trackball>;
        input-processors = <&pointer_accel /* など */>;

        scroller_v {
            layers = <5>;
            input-processors = <
                &zip_y_scaler (-1) 1
                &zip_xy_to_scroll_mapper
                &scroll_inertia_v
                &zip_scroll_scaler 4 675
            >;
        };
};

&default_transform {
    col-offset = <6>;
};
